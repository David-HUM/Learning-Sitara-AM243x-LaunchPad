## CMakeLists.txt
```
cmake_minimum_required(VERSION 3.28.0)

find_package(Zephyr REQUIRED HINTS $ENV{ZEPHYR_BASE})
project(hola_zephyr)

target_sources(app PRIVATE src/main.c src/boot_trace.c)

if(CONFIG_HOLA_EARLY_UART_TRACE)
  target_sources(app PRIVATE src/early_uart_trace.S)
  zephyr_linker_sources(ROM_START SORT_KEY "0x2hola_trace" early_uart_trace.ld)
  zephyr_link_libraries(
    -Wl,--wrap=z_arm_reset
    -Wl,--wrap=z_prep_c
    -Wl,--wrap=z_cstart)
endif()

# Scope the ARMv7-R DT-region compatibility fix to this app's MPU library.
if(CONFIG_ARM_MPU)
  target_compile_options(arch__arm__core__mpu PRIVATE
    -include ${CMAKE_CURRENT_SOURCE_DIR}/mpu_dt_compat.h)
endif()
```

## Kconfig
```
mainmenu "Hola Zephyr"

source "Kconfig.zephyr"

config HOLA_EARLY_UART_TRACE
	bool "Trace early boot directly through UART0"
	depends on CPU_CORTEX_R5
	default n
	help
	  Emit stackless UART markers in reset assembly, kernel startup, VIM,
	  PRE_KERNEL_1, and main entry.
	  Early markers use inherited SBL UART0 configuration and bounded
	  polling without Zephyr console, logger, interrupts or timer.
```

## prj.conf
```kconfig
# Consola UART de la placa, sin shell.
CONFIG_SERIAL=y
CONFIG_CONSOLE=y
CONFIG_UART_CONSOLE=y
CONFIG_PRINTK=y
CONFIG_MULTITHREADING=y
CONFIG_SHELL=n

# Prueba de arranque con MPU y diagnóstico visible por UART.
CONFIG_ARM_MPU=y
CONFIG_BOOT_BANNER=y
CONFIG_EARLY_CONSOLE=y
CONFIG_ASSERT=y
CONFIG_FAULT_DUMP=2
CONFIG_LOG=y
CONFIG_LOG_MODE_IMMEDIATE=y
CONFIG_LOG_BACKEND_UART=y
# Mantener printk directo, independiente del backend de logging.
CONFIG_LOG_PRINTK=n
CONFIG_LOG_DEFAULT_LEVEL=4

# Marcadores directos antes del kernel; desactivar con n para quitarlos.
CONFIG_HOLA_EARLY_UART_TRACE=y
```

## app.overlay
```dts
#include <zephyr/dt-bindings/memory-attr/memory-attr-arm.h>

/*
 * Reserve the existing 1 KiB ROMSTART region for vectors and the early
 * marker. Keep other ATCM allocations outside that region. Describe
 * full, aligned ATCM separately for the MPU, including vectors at zero.
 */
&atcm {
	reg = <0x400 0x7c00>;
	/delete-property/ zephyr,memory-attr;
};

/ {
	mpu-memory {
		compatible = "simple-bus";
		#address-cells = <1>;
		#size-cells = <1>;
		ranges;

		atcm_mpu: memory@0 {
			compatible = "zephyr,memory-region";
			reg = <0x0 0x8000>;
			zephyr,memory-region = "ATCM_MPU";
			zephyr,memory-attr = <DT_MEM_ARM_MPU_RAM>;
		};
	};
};
```

## src/main.c
```c
#include <zephyr/kernel.h>
#include <zephyr/sys/printk.h>

#ifdef CONFIG_HOLA_EARLY_UART_TRACE
void hola_trace_z8(void);
#endif

int main(void)
{
#ifdef CONFIG_HOLA_EARLY_UART_TRACE
	hola_trace_z8();
#endif
	for (;;) {
		printk("hola soy zephyr\n");
		k_sleep(K_SECONDS(3));
	}

	return 0;
}
```

## src/boot_trace.c
```c
#include <zephyr/init.h>

#ifdef CONFIG_HOLA_EARLY_UART_TRACE
void hola_trace_z3(void);
void hola_trace_z4(void);
void hola_trace_z4a(void);
void hola_trace_z4b(void);
void hola_trace_z4c(void);
void hola_trace_z5(void);
void hola_trace_z6(void);
void hola_trace_z7(void);

static int trace_early_init(void)
{
	hola_trace_z3();
	return 0;
}
SYS_INIT(trace_early_init, EARLY, 0);

static int trace_pre_kernel_1(void)
{
	hola_trace_z4();
	return 0;
}
SYS_INIT(trace_pre_kernel_1, PRE_KERNEL_1, 0);

static int trace_pinctrl_init_returned(void)
{
	hola_trace_z4a();
	return 0;
}
SYS_INIT(trace_pinctrl_init_returned, PRE_KERNEL_1, 41);

static int trace_uart_init_returned(void)
{
	hola_trace_z4b();
	return 0;
}
SYS_INIT(trace_uart_init_returned, PRE_KERNEL_1, 51);

static int trace_uart_console_init_returned(void)
{
	hola_trace_z4c();
	return 0;
}
SYS_INIT(trace_uart_console_init_returned, PRE_KERNEL_1, 61);

static int trace_pre_kernel_2(void)
{
	hola_trace_z5();
	return 0;
}
SYS_INIT(trace_pre_kernel_2, PRE_KERNEL_2, 0);

static int trace_post_kernel(void)
{
	hola_trace_z6();
	return 0;
}
SYS_INIT(trace_post_kernel, POST_KERNEL, 0);

static int trace_application(void)
{
	hola_trace_z7();
	return 0;
}
SYS_INIT(trace_application, APPLICATION, 0);
#endif
```
